VERSION "HIPBNYYYYYYYYYYYYYYYYYYYYYYYYYYYYYYYYYYYYY/4/%%%/4/'%**4YYY///"

NS_ :

BS_:

BU_: NewNode0

BO_ 1024 NewMessage0: 8 NewNode0
 SG_ double_signal_0 : 0|64@1- (1,0) [0|0] "" Vector__XXX

SIG_VALTYPE_ 1024 double_signal_0 : 2;
