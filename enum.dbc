VERSION ""

NS_ :

BS_:

BU_: Destination IVT_30_Node

BO_ 2147483938 IVTSleepAck: 1 IVT_30_Node
 SG_ ivt_sleep_ack : 0|4@1- (1,0) [0|0] ""  Destination

BO_ 3 IVTCtrl: 8 Destination ,IVT_30_Node
 SG_ ivt_ctrl_fuse_state : 13|1@1+ (1,0) [0|0] ""  IVT_30_Node

BO_ 1 Enum1: 8 Destination
 SG_ state : 0|4@1+ (1,0) [0|0] ""  A_node

BO_ 4 Enum2: 8 Destination
 SG_ state : 0|4@1+ (1,0) [0|0] ""  A_node

CM_ BO_ 2147483938 "Control message 1.";
CM_ SG_ 2147483938 ivt_sleep_ack "cm 1";
CM_ BO_ 3 "Control message 2.";
CM_ SG_ 3 ivt_ctrl_fuse_state "cm 1";
BA_DEF_  "Version" STRING ;
BA_DEF_  "SyncJumpWidthMin" INT 1 4;
BA_DEF_  "SyncJumpWidthMax" INT 1 4;
BA_DEF_  "SamplePointMin" INT 1 100;
BA_DEF_  "SamplePointMax" INT 1 100;
BA_DEF_  "Baudrate" INT 250000 1000000;
BA_DEF_  "BusType" STRING ;
BA_DEF_ BO_  "GenMsgCycleTime" INT 0 65535;
BA_DEF_DEF_  "Version" "1_1_0_Released";
BA_DEF_DEF_  "SyncJumpWidthMin" 1;
BA_DEF_DEF_  "SyncJumpWidthMax" 1;
BA_DEF_DEF_  "SamplePointMin" 1;
BA_DEF_DEF_  "SamplePointMax" 1;
BA_DEF_DEF_  "Baudrate" 500000;
BA_DEF_DEF_  "BusType" "CAN";
BA_DEF_DEF_  "GenMsgCycleTime" 0;
BA_ "SyncJumpWidthMin" 2;
BA_ "SyncJumpWidthMax" 4;
BA_ "SamplePointMin" 80;
BA_ "SamplePointMax" 84;
BA_ "GenMsgCycleTime" BO_ 3 100;
VAL_ 1 state 0 "INACTIVE" 1 "ACTIVE";
VAL_ 2 state 3 "OFF" 4 "ON";
VAL_ 3 ivt_ctrl_fuse_state 1 "FUSE_AND_FUSE_CLOSED" 0 "FUSE_OR_FUSE_OPEN";
VAL_ 2147483938 ivt_sleep_ack 15 "RESERVED_15" 14 "RESERVED_14" 13 "RESERVED_13" 12 "RESERVED_12" 11 "RESERVED_11" 10 "RESERVED_10" 9 "RESERVED_9" 8 "RESERVED_8" 7 "RESERVED_7" 6 "RESERVED_6" 5 "RESERVED_5" 4 "RESERVED_4" 3 "RESERVED_3" 2 "RESERVED_2" 1 "SLEEP_REQUEST_ACKNOWLEDGED" 0 "SLEEP_REQUEST_NOT_ACKNOWLEDGED";
